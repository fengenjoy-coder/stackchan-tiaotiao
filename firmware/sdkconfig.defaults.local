## firmware/sdkconfig.defaults.local
```kconfig
# BEGIN STACKCHAN MANAGED VOICE PROFILE
# voice_profile=xiaozhi-conversational
# audio_profile=wakenet
# transport_profile=xiaozhi-plus-action
# language_profile=zh-cn
CONFIG_LANGUAGE_ZH_CN=y
# CONFIG_LANGUAGE_ZH_TW is not set
# CONFIG_LANGUAGE_EN_US is not set
# CONFIG_LANGUAGE_JA_JP is not set
# CONFIG_LANGUAGE_KO_KR is not set
# CONFIG_LANGUAGE_VI_VN is not set
# CONFIG_LANGUAGE_TH_TH is not set
# CONFIG_LANGUAGE_DE_DE is not set
# CONFIG_LANGUAGE_FR_FR is not set
# CONFIG_LANGUAGE_ES_ES is not set
# CONFIG_LANGUAGE_IT_IT is not set
# CONFIG_LANGUAGE_RU_RU is not set
# CONFIG_LANGUAGE_AR_SA is not set
# CONFIG_LANGUAGE_HI_IN is not set
# CONFIG_LANGUAGE_PT_PT is not set
# CONFIG_LANGUAGE_PL_PL is not set
# CONFIG_LANGUAGE_CS_CZ is not set
# CONFIG_LANGUAGE_FI_FI is not set
# CONFIG_LANGUAGE_TR_TR is not set
# CONFIG_LANGUAGE_ID_ID is not set
# CONFIG_LANGUAGE_UK_UA is not set
# CONFIG_LANGUAGE_RO_RO is not set
# CONFIG_LANGUAGE_BG_BG is not set
# CONFIG_LANGUAGE_CA_ES is not set
# CONFIG_LANGUAGE_DA_DK is not set
# CONFIG_LANGUAGE_EL_GR is not set
# CONFIG_LANGUAGE_FA_IR is not set
# CONFIG_LANGUAGE_FIL_PH is not set
# CONFIG_LANGUAGE_HE_IL is not set
# CONFIG_LANGUAGE_HR_HR is not set
# CONFIG_LANGUAGE_HU_HU is not set
# CONFIG_LANGUAGE_MS_MY is not set
# CONFIG_LANGUAGE_NB_NO is not set
# CONFIG_LANGUAGE_NL_NL is not set
# CONFIG_LANGUAGE_SK_SK is not set
# CONFIG_LANGUAGE_SL_SI is not set
# CONFIG_LANGUAGE_SV_SE is not set
# CONFIG_LANGUAGE_SR_RS is not set
CONFIG_STACKCHAN_VOICE_MODE_XIAOZHI_CONVERSATIONAL=y
# CONFIG_STACKCHAN_VOICE_MODE_MCP_SINGLE_SHOT is not set
CONFIG_STACKCHAN_TOUCH_PTT=y
CONFIG_USE_AFE_WAKE_WORD=y
# CONFIG_USE_CUSTOM_WAKE_WORD is not set
CONFIG_SR_WN_WN9_NIHAOXIAOZHI_TTS=y
# CONFIG_SR_MN_CN_MULTINET6_QUANT is not set
CONFIG_USE_AUDIO_PROCESSOR=y
# CONFIG_USE_DEVICE_AEC is not set
# CONFIG_USE_SERVER_AEC is not set
# CONFIG_DISABLE_OTA_WEBSOCKET_CONFIG is not set
CONFIG_FORCE_DEFAULT_WEBSOCKET_URL=y
CONFIG_DEFAULT_WEBSOCKET_URL="ws://192.168.9.243:8000/xiaozhi/v1/"
CONFIG_DEFAULT_WEBSOCKET_FALLBACK_URL=""
CONFIG_DEFAULT_WEBSOCKET_TOKEN=""
CONFIG_STACKCHAN_MCP_ACTION_GATEWAY_URL=""
CONFIG_STACKCHAN_MCP_ACTION_GATEWAY_TOKEN=""
# END STACKCHAN MANAGED VOICE PROFILE
CONFIG_CUSTOM_WAKE_WORD="tiao tiao lao shi"
CONFIG_CUSTOM_WAKE_WORD_DISPLAY="跳跳老师"
CONFIG_CUSTOM_WAKE_WORD_THRESHOLD=15
CONFIG_OTA_URL="http://192.168.9.243:8003/xiaozhi/ota/"
```
